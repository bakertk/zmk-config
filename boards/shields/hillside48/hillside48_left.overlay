/*
 * Copyright (c) 2021 The ZMK Contributors
 *
 * SPDX-License-Identifier: MIT
 */

#include "hillside48.dtsi" 
#include <dt-bindings/led/led.h>

&kscan0 {
    col-gpios
        = <&pro_micro 19 GPIO_ACTIVE_HIGH> // col0 in the schematic
        , <&pro_micro 18 GPIO_ACTIVE_HIGH> // col1 in the schematic
        , <&pro_micro 15 GPIO_ACTIVE_HIGH> // col2 in the schematic
        , <&pro_micro 14 GPIO_ACTIVE_HIGH> // col3 in the schematic
        , <&pro_micro 16 GPIO_ACTIVE_HIGH> // col4 in the schematic
        , <&pro_micro 10 GPIO_ACTIVE_HIGH> // col5 in the schematic
        ;
};

/ {
    led_strip: ws2812 {
        compatible = "worldsemi,ws2812-gpio";
        chain-length = <1>;
        color-mapping = <LED_COLOR_ID_GREEN LED_COLOR_ID_RED LED_COLOR_ID_BLUE>;
        gpios = <&pro_micro 1 0>;
    };

    chosen {
        zmk,underglow = &led_strip;
    };
};
