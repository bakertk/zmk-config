## boards/shields/hypergarlic/Kconfig.shield
```kconfig
# Copyright (c) 2020 Pete Johanson
# SPDX-License-Identifier: MIT

config SHIELD_hypergarlic_LEFT
	def_bool $(shields_list_contains,hypergarlic_left)

config SHIELD_hypergarlic_RIGHT
	def_bool $(shields_list_contains,hypergarlic_right)
```

## config/west.yml
```yaml
manifest:
  remotes:
    - name: zmkfirmware
      url-base: https://github.com/zmkfirmware
    - name: urob
      url-base: https://github.com/urob
    - name: awkannan
      url-base: https://github.com/awkannan
  projects:
    - name: zmk
      remote: awkannan
      revision: develop
      import: app/west.yml
    - name: zmk-tri-state
      remote: urob
      revision: main
    - name: zmk-smart-rgbled-widget
      remote: awkannan
      revision: main
  self:
    path: config
```
